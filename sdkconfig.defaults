## sdkconfig.defaults
```kconfig
# ESP Event Loop on Linux
CONFIG_ESP_EVENT_POST_FROM_ISR=n
CONFIG_ESP_EVENT_POST_FROM_IRAM_ISR=n

# Disable WebSocket TLS verification
# Production needs to include specific cert chain you care about
CONFIG_ESP_TLS_INSECURE=y
CONFIG_ESP_TLS_SKIP_SERVER_CERT_VERIFY=y

# Enable DTLS-SRTP
CONFIG_MBEDTLS_SSL_PROTO_DTLS=y

# libpeer requires large stack allocations
CONFIG_PTHREAD_TASK_STACK_SIZE_DEFAULT=8192

# Defaults to partitions.csv
CONFIG_PARTITION_TABLE_CUSTOM=y

# Set highest CPU Freq
CONFIG_ESP_DEFAULT_CPU_FREQ_MHZ_240=y

CONFIG_SPIRAM=y
CONFIG_SPIRAM_MODE_OCT=y
CONFIG_SPIRAM_MALLOC_ALWAYSINTERNAL=4096
CONFIG_SPIRAM_TRY_ALLOCATE_WIFI_LWIP=y

# Enable Compiler Optimization
CONFIG_COMPILER_OPTIMIZATION_PERF=y

CONFIG_WS_BUFFER_SIZE=2048
CONFIG_ESP_SYSTEM_PANIC_PRINT_HALT=y

CONFIG_I2S_ENABLE_V1=n
CONFIG_I2S_ENABLE_V2=y
```
